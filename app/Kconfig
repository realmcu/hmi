## app/Kconfig
```kconfig
choice
    prompt "Select HoneyGUI APP"
    default HONEYGUI_APP_DASHBOARD
    optional
    help
      Select HoneyGUI application to build

config HONEYGUI_APP_DASHBOARD
    bool "Dashboard APP"
    help
      Enable HoneyGUI Dashboard application

endchoice

if HONEYGUI_APP_DASHBOARD

config DASHBOARD_THIRD_PARTY_NAV
    bool "Third-party navigation mirror"
    depends on WLAN
    default n
    help
      Route the dashboard screen-cast path through the third-party navigation
      mirror SDK instead of the built-in WiFi SoftAP + carplay image receiver.

      When this is enabled AND a prebuilt SDK static library is present under
      the dashboard app's third_party_nav/lib/ directory, the two screen-cast
      paths are mutually exclusive:
        * on boot the device brings up the third-party SDK's own SoftAP + mirror
          (instead of the built-in wifi SoftAP / img_rx TCP receiver), and
        * the menu enter key switches to "third_party_nav_view" (instead of
          "carplay_view").

      When disabled (or when the third_party_nav/ SDK library is absent) the
      dashboard uses the built-in WiFi SoftAP + carplay_view image-receiver
      path, and the third-party sources/static library are not compiled or
      linked at all.

rsource "dashboard/bt_ext/bt_classic/Kconfig"
endif
```

## app/dashboard/bt_ext/bt_classic/Kconfig
```kconfig
menu "BT Classic Profile Configuration"
    # These profiles live in the dashboard bt_ext code (compiled under CONFIG_BT_EXT),
    # so hide the whole menu (A2DP/AVRCP/HFP/SPP/HID) unless BT EXT is enabled.
    depends on HONEYGUI_APP_DASHBOARD && BT_EXT

config BT_CLASSIC_ENABLE_A2DP
    bool "A2DP (Advanced Audio Distribution Profile)"
    default y
    help
        Enable A2DP Sink for high-quality audio streaming.

config BT_CLASSIC_ENABLE_AVRCP
    bool "AVRCP (Audio/Video Remote Control Profile)"
    default y if BT_CLASSIC_ENABLE_A2DP
    default n
    help
        Enable AVRCP Controller/Target for remote control of audio playback.
        Typically used together with A2DP.

config BT_CLASSIC_ENABLE_HFP
    bool "HFP (Hands-Free Profile)"
    default n
    help
        Enable HFP for hands-free call relay (phone-to-headphone bridge).

config BT_CLASSIC_ENABLE_SPP
    bool "SPP (Serial Port Profile)"
    default n
    help
        Enable SPP for serial port emulation over Bluetooth.

config BT_CLASSIC_ENABLE_HID
    bool "HID (Human Interface Device)"
    default n
    help
        Enable HID for keyboard/mouse/input device support.
endmenu
```

## app/spi_at_master/Kconfig
```kconfig
#
# Copyright (c) 2026, Realtek Semiconductor Corporation
#
# SPDX-License-Identifier: LicenseRef-Realtek-5-Clause
#

menu "SPI AT master (external 8711 Wi-Fi)"

config WIFI_8711
	bool "External 8711 Wi-Fi chip over SPI"
	select SPI_AT_MASTER
	default n
	help
	  "An external 8711FA Wi-Fi companion exists."  Role-agnostic on
	  purpose: this is the symbol every Wi-Fi caller in app/protocol
	  (port_softap, port_tcp, jpgs_ingress, ebfs_ingress, cmd_debug) is
	  guarded on, so it is what "pause the Wi-Fi features" turns off --
	  each of those files has a working #else stub.

	  It selects SPI_AT_MASTER, which is the transport: WE drive SCLK and
	  CS and the 8711 runs Realtek's standard AT command set.  Turned on by
	  the wifi snippet, which also supplies the devicetree nodes that
	  transport binds to -- enabling the symbol on its own will not build.

	  DECLARED HERE, ALONGSIDE THE TRANSPORT IT SELECTS, because the module
	  it used to live in is gone.  It was app/wifi_8711/Kconfig's, back when
	  this symbol MEANT that module -- the SPI slave stack talking to an
	  8711 running custom in-house AT firmware.  The slave role was retired
	  in favour of the master role (10 MHz vs 25, and a vendor-supported
	  command set instead of one we maintained), the module was deleted, and
	  the symbol outlived it because "an 8711 exists" is a fact about the
	  BOARD rather than about which transport implements it.  Keeping the
	  name is what spares every #if in app/protocol from churning.

config SPI_AT_MASTER
	bool "AT-over-SPI toward the 8711, WE are the master"
	select SPI
	select SPI_RTL87X3G_DMA
	select DMA
	select GPIO
	default n
	help
	  The transport for the reversed-role SPI link: we drive SCLK and CS
	  at 25 MHz, the 8711 is the slave, and the two sync lines swap direction
	  (P4_1 becomes our input, P2_7 our output).  Frames are 16 KiB slots
	  carrying an 'A','T',len16 header, matching the vendor reference
	  example/atcmd_host/atcmd_host_spi.  Above it sit at_parser, at_client
	  and then at_wifi / at_socket, which is what app/protocol talks to.

	  Turned on by the wifi snippet, which also supplies the spi1_hs /
	  spi_at_master_resources / spi_at_master_device / psram1_nc devicetree
	  nodes this module binds to.  Enabling the symbol alone will not
	  build -- the DT nodes must come with it.

	  Selected by WIFI_8711 above, which is the role-agnostic "an external
	  8711 exists" switch that app/protocol's guards test.  It used to be
	  `depends on !WIFI_8711` instead, because that symbol then meant the
	  SLAVE stack and both claim P4_2..P4_5 -- the slave role has since been
	  retired and deleted, so the two are one arrangement rather than two
	  and there is no mutual exclusion left to express.

config SPI_AT_MASTER_SHELL
	bool "atm shell command group"
	depends on SPI_AT_MASTER && SHELL
	default y
	help
	  Register the `atm` shell commands: forward a typed AT command line to
	  the 8711 over SPI, hexdump both directions, and read back the sync
	  line levels and counters.  Defaults on because it is the only way to
	  drive the link by hand -- it was the harness's whole user interface
	  once, and it is still how you separate "the 8711 is not answering"
	  from "app/protocol never asked it anything".

endmenu
```

## app/wifi_8711/Kconfig
```kconfig
#
# Copyright (c) 2026, Realtek Semiconductor Corporation
#
# SPDX-License-Identifier: LicenseRef-Realtek-5-Clause
#

menu "WIFI 8711 (external Wi-Fi companion) module"

config WIFI_8711
	bool "External 8711 Wi-Fi chip over SPI"
	select SPI_AT_MASTER
	default n
	help
	  "An external 8711FA Wi-Fi companion exists."  Role-agnostic on
	  purpose: this is the symbol every Wi-Fi caller in app/protocol
	  (port_softap, port_tcp, jpgs_ingress, ebfs_ingress, cmd_debug) is
	  already guarded on, so it is what "pause the Wi-Fi features" turns
	  off -- each of those files has a working #else stub.

	  It selects SPI_AT_MASTER, which is the transport: WE drive SCLK and
	  CS and the 8711 runs Realtek's standard AT command set.  Turned on by
	  the wifi snippet, which also supplies the devicetree nodes that
	  transport binds to -- enabling the symbol on its own will not build.

	  It used to mean the SLAVE stack in app/wifi_8711/ instead.  That code
	  is now gated on WIFI_8711_ROLE_SLAVE (default n) rather than on this
	  symbol, because otherwise turning "an 8711 exists" on would compile a
	  module bound to spi0_slave, a node the wifi overlay does not provide.

config WIFI_8711_ROLE_SLAVE
	bool "SPI slave role (retired -- the custom-firmware stack)"
	depends on WIFI_8711
	select SPI
	select SPI_SLAVE
	default n
	help
	  Build app/wifi_8711/: the SPI slave transport plus the JPGS/ATMC slot
	  engine, talking to an 8711 running the CUSTOM in-house AT firmware
	  that understood the eBadge protocol.  The 8711 drove SCLK and CS and
	  we parked a 4096-byte slot in TX DMA waiting to be clocked.

	  RETIRED, and default n for two reasons rather than one: the standard
	  firmware replaced it, and the slave role capped the link at 10 MHz
	  where the master role reaches 25.  Kept buildable for bisecting
	  against known-good behaviour, not for shipping.

	  Needs the wifi_8711 snippet, not the wifi one -- it binds to
	  spi0_slave, and spi_rtl87x3g.c BUILD_ASSERTs that spi1 and spi1_hs
	  are not both okay, so the two overlays cannot be combined.

config WIFI_8711_TEST
	bool "wifi8711 shell command group"
	depends on WIFI_8711_ROLE_SLAVE && SHELL
	default n
	help
	  Register the `wifi8711` shell commands for the slave transport: probe
	  the DT bindings, drive the B2W line, and read W2B.

	  Depends on the ROLE_SLAVE symbol rather than on WIFI_8711, because
	  wifi_8711_shell.c lives in the module that symbol gates -- hanging it
	  off "an 8711 exists" would ask CMake for a source file the guard above
	  excluded.  The master role's equivalent is the `atm` group
	  (SPI_AT_MASTER_SHELL).

endmenu
```

## chargecase/Kconfig
```kconfig
#
# Copyright (c) 2026, Realtek Semiconductor Corporation
#
# SPDX-License-Identifier: LicenseRef-Realtek-5-Clause
#
mainmenu "realtek honeygui mainmenu"

menu "honeygui"
rsource "../../../src/Kconfig"
endmenu

config REALTEK_APP_HONEYGUI_DEMO_SUPPORT
   bool
   default y

config REALTEK_BUILD_CJSON
   bool
   default y  

rsource "../../../Kconfig"
```

## deskmate/Kconfig
```kconfig
# Copyright (c) 2024, Realtek Semiconductor Corporation.
# SPDX-License-Identifier: Apache-2.0

menu "DeskMate Application"

config RTK_BT_BREDR
	bool "Enable Classic Bluetooth (BR/EDR) support"
	default n
	select REALTEK_SUBSYS_BTM
	select REALTEK_SUBSYS_SYSM
	select REALTEK_SUBSYS_REMOTE
	help
	  Enable Realtek Classic Bluetooth BR/EDR stack.
	  Activates BTM, SYSM, and Remote subsystems.

endmenu

menu "Zephyr Kernel"
source "Kconfig.zephyr"
endmenu
```

## mdk/Kconfig
```kconfig
mainmenu "RT-Thread Configuration"

config BSP_DIR
    string
    default "../../../../src/app/wristband"

config RTT_DIR
    string
	default "../../../../src/os/rt-thread"

config PKGS_DIR
    string
    option env="PKGS_ROOT"
    default "packages"
 
source "$RTT_DIR/Kconfig"
source "$PKGS_DIR/Kconfig"
source "$BSP_DIR/Kconfig"
```

## port/posix/port/zephyr-rtk/Kconfig
```kconfig
config POSIX_DEVICE_RTK_ZEPHYR
	bool "POSIX device abstraction layer for RTK8773G + Zephyr"
	default y
	help
	  Enable POSIX device abstraction layer for RTL8773G.
	  Provides open/close/read/write/ioctl for LCD/Touch/GPIO/UART/SPI.

config POSIX_DEVICE_LCD
	bool "POSIX LCD driver (RTK SH8601Z QSPI)"
	depends on POSIX_DEVICE_RTK_ZEPHYR
	default y

config POSIX_DEVICE_TOUCH
	bool "POSIX Touch driver (CHSC6417)"
	depends on POSIX_DEVICE_RTK_ZEPHYR
	default y

config POSIX_DEVICE_GSENSOR
	bool "POSIX G-Sensor driver (stub)"
	depends on POSIX_DEVICE_RTK_ZEPHYR
	default n

config POSIX_DEVICE_GPIO
	bool "POSIX GPIO driver (RTK SDK)"
	depends on POSIX_DEVICE_RTK_ZEPHYR
	default y

config POSIX_DEVICE_UART
	bool "POSIX UART driver (RTK SDK)"
	depends on POSIX_DEVICE_RTK_ZEPHYR
	default y
```
