/*
 * Copyright (c) 2024, Realtek Semiconductor Corporation. All rights reserved.
 */

/ {
	chosen {
		zephyr,console = &uart2;
		zephyr,shell-uart = &uart2;
	};
};

&uart2 {
	status = "okay";
	current-speed = <2000000>;
};
